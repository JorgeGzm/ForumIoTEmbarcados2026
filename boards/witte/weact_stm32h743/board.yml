## boards/witte/weact_stm32h743/board.yml
```yaml
board:
  name: weact_stm32h743
  full_name: Weact STM32H743 Core Board
  vendor: witte
  socs:
    - name: stm32h743xx
```

## gzm/lib/Kconfig
```kconfig
#
# Copyright (c) 2026 GZM Embarcados
#

menu "GZM Libraries"

rsource "fs_mgr/Kconfig"
rsource "user_mgr/Kconfig"

endmenu
```

## gzm/lib/fs_mgr/Kconfig
```kconfig
#
# Copyright (c) 2026 GZM Embarcados
#

config GZM_FS_MGR
	bool "Filesystem manager (mount + high-level file helpers)"
	depends on FILE_SYSTEM
	default n
	help
	  Filesystem manager with mount/format/deinit, one-shot file
	  read/write/delete, directory listing, disk space info, and
	  mkdir-if-not-exists helper.

	  Formerly: zlib/xfs (CONFIG_ZLIB_FS).
```

## gzm/lib/user_mgr/Kconfig
```kconfig
#
# Copyright (c) 2026 GZM Embarcados
#

config GZM_USER_MGR
	bool "User manager (accounts with PBKDF2-HMAC-SHA256 hashed passwords)"
	default n
	depends on FILE_SYSTEM
	depends on PSA_CRYPTO_CLIENT
	select CRC
	select GZM_FS_MGR
	select PSA_WANT_ALG_PBKDF2_HMAC
	select PSA_WANT_ALG_HMAC
	select PSA_WANT_ALG_SHA_256
	select ENTROPY_GENERATOR
	help
	  Passwords are derived with PBKDF2-HMAC-SHA256 through the PSA
	  Crypto API (CONFIG_PSA_CRYPTO).

	  Account store with one file per user on any Zephyr filesystem
	  (FatFS, LittleFS, …).  Passwords are never persisted in the
	  clear: the library keeps only the salt, iteration count and
	  PBKDF2-HMAC-SHA256 derived key.  Lookups hit an in-RAM sorted
	  index (O(log n)); disk I/O only runs on create/update/delete
	  and on boot while the index is loaded.

if GZM_USER_MGR

config GZM_USER_MGR_MAX
	int "Maximum number of users"
	default 50
	range 1 10000
	help
	  Capacity of the store: user_mgr_add() returns -ENOSPC once it is
	  full. Also the size of the in-RAM index (8 bytes per user).

config GZM_USER_MGR_FIRST_NAME_LEN
	int "Maximum first-name length (bytes, excluding null terminator)"
	default 24
	range 4 128

config GZM_USER_MGR_LAST_NAME_LEN
	int "Maximum last-name length (bytes, excluding null terminator)"
	default 36
	range 4 128

config GZM_USER_MGR_PASSWORD_MAX_LEN
	int "Maximum accepted password length (bytes, excluding null terminator)"
	default 32
	range 4 128
	help
	  Upper bound on the password that may be passed to
	  user_mgr_add / user_mgr_set_password / user_mgr_login.  Not
	  stored on disk.

config GZM_USER_MGR_SALT_LEN
	int "Salt length in bytes"
	default 16
	range 8 32

config GZM_USER_MGR_PBKDF2_ITERATIONS
	int "Default PBKDF2-HMAC-SHA256 iterations"
	default 10000
	range 1000 200000
	help
	  Applied on every new account and whenever a password is
	  changed.  Existing records keep whatever iteration count they
	  were created with, so raising this here is safe for forward
	  migration.

config GZM_USER_MGR_SHELL
	bool "Shell commands (user …)"
	default y
	depends on SHELL

endif # GZM_USER_MGR
```

## gzm/zephyr/Kconfig
```kconfig
#
# Copyright (c) 2026 GZM Embarcados
#

menu "GZM Zephyr Modules"

rsource "../lib/Kconfig"

endmenu
```

## manifest/west.yml
```yaml
manifest:
  self:
    path: manifest

  remotes:
    - name: zephyrproject-rtos
      url-base: https://github.com/zephyrproject-rtos

  projects:
    # Pinned to a release for demo stability (talk: "Do Código ao Campo").
    - name: zephyr
      remote: zephyrproject-rtos
      revision: v4.4.1
      import:
        # Clone only the modules this demo needs.
        name-allowlist:
          - cmsis            # ARM Cortex-A/R headers
          - cmsis_6          # ARM Cortex-M headers (CMSIS 6)
          - hal_stm32        # STM32 HAL (STM32H743)
          - picolibc         # C library
          - littlefs         # LittleFS (user store on the SPI NOR)
          - lvgl             # LVGL graphics library
          - mbedtls          # crypto (MCUboot, PBKDF2 of the user passwords)
          - tf-psa-crypto    # required by mbedtls >= 4.x
          - mcuboot          # bootloader + imgtool
          - zcbor            # CBOR (MCUboot serial recovery / SMP)
```

## tests/user_mgr_mock/testcase.yaml
```yaml
tests:
  demo.user_mgr.mock:
    platform_allow:
      - native_sim
      - native_sim/native/64
    integration_platforms:
      - native_sim/native/64
    tags:
      - demo
      - user_mgr
      - fff
```
